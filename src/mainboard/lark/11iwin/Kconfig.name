## src/mainboard/lark/11iwin/Kconfig.name
```kconfig
## SPDX-License-Identifier: GPL-2.0-only

comment "11iwin"

config BOARD_LARK_11IWIN
	bool "->  Lark Ultimate 11I Win"
```

## src/mainboard/lark/Kconfig
```kconfig
## SPDX-License-Identifier: GPL-2.0-only

if VENDOR_LARK

choice
	prompt "Mainboard model"

source "src/mainboard/lark/*/Kconfig.name"

endchoice

source "src/mainboard/lark/*/Kconfig"

config MAINBOARD_VENDOR
	default "Lark"

endif # VENDOR_LARK
```
